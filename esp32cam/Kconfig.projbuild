## esp32cam/Kconfig.projbuild
```kconfig
menu "Camera WiFi Config"

    config WIFI_SSID
        string "WiFi SSID"
        default "myssid"
        help
            SSID of the WiFi network to connect to.

    config WIFI_PASSWORD
        string "WiFi Password"
        default "mypassword"
        help
            WiFi password.

endmenu
```

## esp32cam/sdkconfig.defaults
```kconfig
# WiFi
CONFIG_WIFI_SSID="YOUR_SSID"
CONFIG_WIFI_PASSWORD="YOUR_PASS"

# Target
CONFIG_IDF_TARGET="esp32s3"

# Flash: 16MB, OPI PSRAM: 8MB (N16R8)
CONFIG_ESPTOOLPY_FLASHSIZE_16MB=y
CONFIG_ESPTOOLPY_FLASHSIZE="16MB"
CONFIG_SPIRAM=y
CONFIG_SPIRAM_MODE_OCT=y
CONFIG_SPIRAM_SPEED_80M=y
CONFIG_SPIRAM_FETCH_INSTRUCTIONS=y
CONFIG_SPIRAM_RODATA=y

# Camera needs larger stack and heap
CONFIG_ESP_MAIN_TASK_STACK_SIZE=8192
CONFIG_SPIRAM_MALLOC_ALWAYSINTERNAL=16384

# HTTP server
CONFIG_HTTPD_MAX_REQ_HDR_LEN=1024
CONFIG_HTTPD_MAX_URI_LEN=512

# Logging
CONFIG_LOG_DEFAULT_LEVEL_INFO=y
```
